// SPDX-License-Identifier: (GPL-2.0+ OR MIT)
/*
 * Copyright 2024 Variscite Ltd.
 */

#include "imx8mm-var-som.dtsi"
#include "imx8mm-var-som-1.x.dtsi"

/ {
	model = "Variscite VAR-SOM-MX8MM V2 on Symphony Board";
};
